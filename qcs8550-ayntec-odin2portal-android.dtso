// SPDX-License-Identifier: BSD-3-Clause
// SPDX-FileCopyrightText: The LineageOS Project

#include "qcs8550-ayntec-odin2portal.dtso"

/ {
	qcom,msm-id = <603 0x20000>;
	qcom,board-id = <0x1001f 0>;
};

&android_firmware {
	hardware = "odin2portal";
};
